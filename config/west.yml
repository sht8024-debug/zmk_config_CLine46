## config/west.yml
```yaml
manifest:
  remotes:
    - name: cormoran
      url-base: https://github.com/cormoran
    - name: badjeff    # <-- PMW3610
      url-base: https://github.com/badjeff
    - name: caksoylar  # <-- RGB LED
      url-base: https://github.com/caksoylar
    - name: takamaru-fpv  # <-- Battery level smoothing
      url-base: https://github.com/takamaru-fpv

  projects:
    # ZMK: DYA Studio 用カスタム RPC サブシステム付き cormoran fork
    # 2026-05-01時点(メーカービルド成功時)のコミットに固定（mainブランチ追従による非互換ビルドエラー回避）
    - name: zmk
      remote: cormoran
      revision: 4493783ef88ce2e653bf8217c92ee17140df71e3
      import: app/west.yml
    - name: zmk-feature-non-lipo-battery-management
      remote: takamaru-fpv
      revision: voltage_division

    # DYA Studio モジュール（すべて cormoran リポジトリ）
    - name: zmk-module-ble-management
      remote: cormoran
      revision: 851661cd21f2aded8ec649da86e01a207dc4b973
    - name: zmk-module-battery-history
      remote: cormoran
      revision: 307755dd2ad4d320e14de162e8e5ef018f29d929
    - name: zmk-module-settings-rpc
      remote: cormoran
      revision: ad1c995cf910ca989ecd6352a1d0b41ccb18362c
    - name: zmk-module-runtime-input-processor
      remote: cormoran
      revision: e1860078f564b0ad49cf301a1f04e13edb9cba25
    - name: zmk-pmw3610-driver
      remote: badjeff
      revision: zmk-0.3
    - name: zmk-rgbled-widget
      remote: caksoylar
      revision: v0.3-branch
  self:
    path: config
```
